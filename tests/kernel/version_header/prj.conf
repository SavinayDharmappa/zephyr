## prj.conf
```kconfig
# nothing here
CONFIG_VERSION_HEADER=y
```

## src/main.c
```c
/*
 * Copyright (c) 2012-2014 Wind River Systems, Inc.
 *
 * SPDX-License-Identifier: Apache-2.0
 */

#include <zephyr.h>
#include <misc/printk.h>
#include "version.h" /* generated by MAKE, at compile time */

void main(void)
{
	printk("Kernel Version is %d\n", KERNELVERSION);
}
```
